## tools/esp_idf_wifi_control/main/Kconfig.projbuild
```kconfig
menu "WiFi Control Configuration"

    config WIFI_CONTROL_SSID
        string "WiFi SSID"
        default ""
        help
            Leave empty to run scan-only control mode.

    config WIFI_CONTROL_PASSWORD
        string "WiFi Password"
        default ""
        help
            Password used only when SSID is non-empty.

    config WIFI_CONTROL_MAXIMUM_RETRY
        int "Maximum connect retry"
        range 0 20
        default 5

    config WIFI_CONTROL_CONNECT_WAIT_MS
        int "Connect wait timeout (ms)"
        range 1000 120000
        default 30000

    config WIFI_CONTROL_SCAN_LIST_SIZE
        int "Max APs to print"
        range 1 32
        default 10

    config WIFI_CONTROL_DISABLE_WIFI_NVS
        bool "Disable WiFi NVS in wifi_init_config_t"
        default n
        help
            When enabled, the control probe sets cfg.nvs_enable = 0 before
            esp_wifi_init(). Use this only for scan/connect diagnostics.

    config WIFI_CONTROL_FORCE_PS_NONE
        bool "Force WIFI_PS_NONE before scan/connect"
        default n

    config WIFI_CONTROL_FORCE_COUNTRY_CN_MANUAL
        bool "Force country CN/manual before scan/connect"
        default n

    config WIFI_CONTROL_FORCE_MAX_TX_POWER_80
        bool "Force max tx power to 80 quarter-dBm units"
        default n

endmenu
```
